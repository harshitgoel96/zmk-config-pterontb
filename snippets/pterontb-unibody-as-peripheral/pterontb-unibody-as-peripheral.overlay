// == Input devices ==
// Converting this old central part to a peripheral part
// - Disabling all input listeners
// - Disabling input-split from other peripheral parts
// - Enabling input-split for its own input devices
// - Assigning devices to input-split
&input_listener_trackball0 { status = "disabled"; };
&input_split_trackball0 { status = "disabled"; };
