## boards/shields/pterontb/Kconfig.defconfig
```kconfig
if SHIELD_PTERONTB_UNIBODY

# Name must be less than 16 characters long!
config ZMK_KEYBOARD_NAME
    default "pteronTB"

config ZMK_SPLIT_ROLE_CENTRAL
    default y

config ZMK_SPLIT_BLE_CENTRAL_PERIPHERALS
  default 1

config BT_MAX_CONN
  default 6

config BT_MAX_PAIRED
  default 6

endif

if SHIELD_PTERONTB_UNIBODY || SHIELD_PTERONTB_TRACKBALL

config ZMK_SPLIT
    default y

config ZMK_POINTING
    default y

endif

if SHIELD_PTERONTB_DONGLE

# Name must be less than 16 characters long!
config ZMK_KEYBOARD_NAME
    default "pteronTB"

config ZMK_POINTING
    default y

config ZMK_SPLIT
    default y

config ZMK_SPLIT_ROLE_CENTRAL
    default y

config ZMK_SPLIT_BLE_CENTRAL_PERIPHERALS
  default 2

config BT_MAX_CONN
  default 7

config BT_MAX_PAIRED
  default 7

endif

# ---------------------
# Kconfig for shield "pterontb_trackball" with board "seeeduino_xiao_ble"
# ---------------------
if BOARD_SEEEDUINO_XIAO_BLE && SHIELD_PTERONTB_TRACKBALL

config SPI
    default y

config PMW3610
    default y

endif
```

## boards/shields/pterontb/Kconfig.shield
```kconfig
config SHIELD_PTERONTB_UNIBODY
    def_bool $(shields_list_contains,pterontb_unibody)
  
config SHIELD_PTERONTB_TRACKBALL
    def_bool $(shields_list_contains,pterontb_trackball)
  
config SHIELD_PTERONTB_DONGLE
    def_bool $(shields_list_contains,pterontb_dongle)
```

## config/west.yml
```yaml
manifest:
  defaults:
    revision: v0.3
  remotes:
    - name: zmkfirmware
      url-base: https://github.com/zmkfirmware
    - name: badjeff
      url-base: https://github.com/badjeff
    - name: carrefinho                            # <--- add this
      url-base: https://github.com/carrefinho 
    - name: kot149
      url-base: https://github.com/kot149 
    # Additional modules containing boards/shields/custom code can be listed here as well
    # See https://docs.zephyrproject.org/3.2.0/develop/west/manifest.html#projects
  projects:
    - name: zmk
      remote: zmkfirmware
      revision: v0.3
      import: app/west.yml
    - name: zmk-pmw3610-driver
      remote: badjeff
      revision: zmk-0.3
    - name: prospector-zmk-module                 # <--- and these
      remote: carrefinho                          # <---
      revision: main 
    - name: zmk-scroll-snap
      remote: kot149
      revision: v1
  self:
    path: config
```
